/*

 Parts of the code comes from here: https://forum.arduino.cc/t/analog-vu-meter-i2c-oled-sh1106-oledmeter-animation/388374

*/

#include <Wire.h>
#include <arduinoFFT.h>
#include <Adafruit_SSD1306.h>

static const unsigned char PROGMEM VUMeter[] = { 
  0x00, 0x00, 0x00, 0x00, 0x00, 0x00, 0x00, 0x00, 0x00, 0x00, 0x00, 0x00, 0x00, 0x00, 0x00, 0x00,
  0x00, 0x00, 0x00, 0x00, 0x00, 0x00, 0x00, 0x00, 0x00, 0x00, 0x00, 0x00, 0x00, 0x00, 0x00, 0x00,
  0x00, 0x00, 0x00, 0x00, 0x00, 0x00, 0x00, 0x00, 0x00, 0x00, 0x00, 0x00, 0x00, 0x00, 0x00, 0x00,
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  0x00, 0x00, 0x00, 0x00, 0x00, 0x00, 0x00, 0x00, 0x00, 0x00, 0x00, 0x00, 0x00, 0x00, 0x00, 0x00
};


#define MODE_UV 0
#define MODE_OSZI 1
#define MODE_FFT 2
#define SAMPLES 128
#define SCREEN_WIDTH 128
#define SCREEN_HEIGHT 64
#define SCREEN_ADDRESS 0x3C

uint8_t mode = MODE_FFT;

Adafruit_SSD1306 display(SCREEN_WIDTH, SCREEN_HEIGHT, &Wire, -1);
arduinoFFT FFT = arduinoFFT();
int hMeter = 65;
int vMeter = 85;
int rMeter = 80;
const int sampleWindow = 50;
unsigned int sample;
double vReal[SAMPLES];
double vImag[SAMPLES];
byte peak;
long maxpeak;
char buf[5];

void setup() {  
    Serial.begin(115200);
    display.begin(SSD1306_SWITCHCAPVCC, SCREEN_ADDRESS);
    display.clearDisplay();   
    display.setTextColor(WHITE);   
    display.display();
}

void loop() {  
    if (mode == MODE_UV) {
        unsigned long startMillis = millis();
        unsigned int PeaktoPeak = 0;
        unsigned int SignalMax = 0;
        unsigned int SignalMin = 1024;
        while ( millis() - startMillis < sampleWindow ){
            sample = analogRead(A0);
            if (sample < 1024) {
                if (sample > SignalMax){
                    SignalMax = sample;
                } else if (sample < SignalMin) {
                    SignalMin = sample;
                }
            }
        }

        PeaktoPeak = SignalMax - SignalMin;
        float MeterValue = PeaktoPeak * 330 / 1024;
        MeterValue = MeterValue - 34;
        display.clearDisplay();
        display.drawBitmap(0, 0, VUMeter, 128, 64, WHITE);
        int a1 = (hMeter + (sin(MeterValue / 57.296) * rMeter));
        int a2 = (vMeter - (cos(MeterValue / 57.296) * rMeter));
        display.drawLine(a1, a2, hMeter, vMeter, WHITE);
        display.display();

    } else if (mode == MODE_OSZI) {
        int center = 470;
        for (byte i = 0; i < 255; i++) {
            if (analogRead(A0) > center) {
                break;
            }
        }
        for (byte i = 0; i < 255; i++) {
            if (analogRead(A0) < center) {
                break;
            }
        }
        for (byte i = 0; i < SAMPLES; i++) {
            vReal[i] = analogRead(A0);
            delayMicroseconds(10);
        }
        display.clearDisplay();
        for (byte i = 0; i < SAMPLES - 1; i++) {
            int val1 = (vReal[i] - center);
            int val2 = (vReal[i+1] - center);
            display.drawLine(i, 32 + val1 / 8, i+1, 32 + val2 / 8, WHITE);
        }
        display.display();

    } else if (mode == MODE_FFT) {
        for (byte i = 0; i < SAMPLES; i++) {
            vReal[i] = analogRead(A0);
            vImag[i] = 0;
            delayMicroseconds(1);
        }
        FFT.DCRemoval();
        FFT.Windowing(vReal, SAMPLES, FFT_WIN_TYP_HAMMING, FFT_FORWARD);
        FFT.Compute(vReal, vImag, SAMPLES, FFT_FORWARD);
        FFT.ComplexToMagnitude(vReal, vImag, SAMPLES);

        display.clearDisplay();
        for (byte i = 0; i < SAMPLES / 2 - 1; i++) {        
            peak = map(vReal[i+2], 0, 1024, 0, 62);    
            display.fillRect(i * 2 + 1, abs(63 - peak), 1, peak, WHITE);
        }  
        maxpeak= FFT.MajorPeak(vReal, SAMPLES, 5000);  
        display.display();  
    }
}

